AUTOSAR XML (schema 00046)
package /AUTOSAR_Pmic/BswModuleDescriptions
  bsw module description Pmic: module-id=255
    provided-entrys:
      Pmic_ConfigureWatchdog
      Pmic_DisableWatchdog
      Pmic_EmulateDeviceOTP
      Pmic_GetDeviceInfo
      Pmic_GetRawFaultEvents
      Pmic_GetVersionInfo
      Pmic_GotoInitFS
      Pmic_Init
      Pmic_InitClock
      Pmic_InitDevice
      Pmic_ReadRegister
      Pmic_ReleaseFs0b
      Pmic_SetAnalogMux
      Pmic_SetMode
      Pmic_SetReactions
      Pmic_SwitchSVS
      Pmic_TriggerWatchdog
      Pmic_WriteRegister
    bsw internal behavior InternalBehavior_0
      4 x exclusive area:
        PMIC_EXCLUSIVE_AREA_{00..03}
      18 x bsw called entity:
        Pmic_ConfigureWatchdog: can-enter-exclusive-area=PMIC_EXCLUSIVE_AREA_00, implemented-entry=Pmic_ConfigureWatchdog
        Pmic_DisableWatchdog: can-enter-exclusive-area=[PMIC_EXCLUSIVE_AREA_00, PMIC_EXCLUSIVE_AREA_01, PMIC_EXCLUSIVE_AREA_03], implemented-entry=Pmic_DisableWatchdog
        Pmic_EmulateDeviceOTP: can-enter-exclusive-area=[PMIC_EXCLUSIVE_AREA_00, PMIC_EXCLUSIVE_AREA_01], implemented-entry=Pmic_EmulateDeviceOTP
        Pmic_GetDeviceInfo: can-enter-exclusive-area=PMIC_EXCLUSIVE_AREA_01, implemented-entry=Pmic_GetDeviceInfo
        Pmic_GetRawFaultEvents: can-enter-exclusive-area=PMIC_EXCLUSIVE_AREA_01, implemented-entry=Pmic_GetRawFaultEvents
        Pmic_GetVersionInfo: implemented-entry=Pmic_GetVersionInfo
        Pmic_GotoInitFS: can-enter-exclusive-area=[PMIC_EXCLUSIVE_AREA_00, PMIC_EXCLUSIVE_AREA_01], implemented-entry=Pmic_GotoInitFS
        Pmic_Init: implemented-entry=Pmic_Init
        Pmic_InitClock: can-enter-exclusive-area=[PMIC_EXCLUSIVE_AREA_00, PMIC_EXCLUSIVE_AREA_01], implemented-entry=Pmic_InitClock
        Pmic_InitDevice: can-enter-exclusive-area=[PMIC_EXCLUSIVE_AREA_00, PMIC_EXCLUSIVE_AREA_01, PMIC_EXCLUSIVE_AREA_02, PMIC_EXCLUSIVE_AREA_03], implemented-entry=Pmic_InitDevice
        Pmic_ReadRegister: can-enter-exclusive-area=PMIC_EXCLUSIVE_AREA_01, implemented-entry=Pmic_ReadRegister
        Pmic_ReleaseFs0b: can-enter-exclusive-area=PMIC_EXCLUSIVE_AREA_03, implemented-entry=Pmic_ReleaseFs0b
        Pmic_SetAnalogMux: can-enter-exclusive-area=PMIC_EXCLUSIVE_AREA_00, implemented-entry=Pmic_SetAnalogMux
        Pmic_SetMode: can-enter-exclusive-area=[PMIC_EXCLUSIVE_AREA_00, PMIC_EXCLUSIVE_AREA_01], implemented-entry=Pmic_SetMode
        Pmic_SetReactions: can-enter-exclusive-area=PMIC_EXCLUSIVE_AREA_00, implemented-entry=Pmic_SetReactions
        Pmic_SwitchSVS: can-enter-exclusive-area=[PMIC_EXCLUSIVE_AREA_00, PMIC_EXCLUSIVE_AREA_01, PMIC_EXCLUSIVE_AREA_03], implemented-entry=Pmic_SwitchSVS
        Pmic_TriggerWatchdog: can-enter-exclusive-area=[PMIC_EXCLUSIVE_AREA_00, PMIC_EXCLUSIVE_AREA_01], implemented-entry=Pmic_TriggerWatchdog
        Pmic_WriteRegister: can-enter-exclusive-area=PMIC_EXCLUSIVE_AREA_00, implemented-entry=Pmic_WriteRegister
package /AUTOSAR_Pmic/BswModuleEntrys
  18 x bsw module entry, all with is-synchronous=true, call-type=REGULAR, execution-context=UNSPECIFIED, sw-service-impl-policy=STANDARD:
    Pmic_ConfigureWatchdog: service-id=0x08, is-reentrant=true
    Pmic_DisableWatchdog: service-id=0x0e, is-reentrant=true
    Pmic_EmulateDeviceOTP: service-id=0x02, is-reentrant=false
    Pmic_GetDeviceInfo: service-id=0x0c, is-reentrant=true
    Pmic_GetRawFaultEvents: service-id=0x0a, is-reentrant=true
    Pmic_GetVersionInfo: service-id=0x0d, is-reentrant=true
    Pmic_GotoInitFS: service-id=0x10, is-reentrant=true
    Pmic_Init: service-id=0x00, is-reentrant=false
    Pmic_InitClock: service-id=0x05, is-reentrant=false
    Pmic_InitDevice: service-id=0x01, is-reentrant=false
    Pmic_ReadRegister: service-id=0x03, is-reentrant=false
    Pmic_ReleaseFs0b: service-id=0x11, is-reentrant=true
    Pmic_SetAnalogMux: service-id=0x07, is-reentrant=true
    Pmic_SetMode: service-id=0x06, is-reentrant=true
    Pmic_SetReactions: service-id=0x0b, is-reentrant=true
    Pmic_SwitchSVS: service-id=0x0f, is-reentrant=true
    Pmic_TriggerWatchdog: service-id=0x09, is-reentrant=false
    Pmic_WriteRegister: service-id=0x04, is-reentrant=false
package /Pmic_TS_T40D11M40I0R0/Implementations
  bsw implementation BswImplementation_0: programming-language=C, sw-version=4.0.0, vendor-id=43, ar-release-version=4.4.0, behavior=InternalBehavior_0, vendor-specific-module-def=Pmic
    code-descriptors:
      code Files
        artifact-descriptors:
          short-label=config::Pmic.xdm, category=SWCFG
          short-label=doc::RTD_PMIC_IM.pdf, category=SWDOC
          short-label=doc::RTD_PMIC_UM.pdf, category=SWDOC
          short-label=examples::EBT::S32G2::Pmic_Configuration_Example_S32G274A_M7::generate::epc::Base.xdm, category=SWCFG
          short-label=examples::EBT::S32G2::Pmic_Configuration_Example_S32G274A_M7::generate::epc::Dem.xdm, category=SWCFG
          short-label=examples::EBT::S32G2::Pmic_Configuration_Example_S32G274A_M7::generate::epc::Dio.xdm, category=SWCFG
          short-label=examples::EBT::S32G2::Pmic_Configuration_Example_S32G274A_M7::generate::epc::EcuC.xdm, category=SWCFG
          short-label=examples::EBT::S32G2::Pmic_Configuration_Example_S32G274A_M7::generate::epc::I2c.xdm, category=SWCFG
          short-label=examples::EBT::S32G2::Pmic_Configuration_Example_S32G274A_M7::generate::epc::Mcu.xdm, category=SWCFG
          short-label=examples::EBT::S32G2::Pmic_Configuration_Example_S32G274A_M7::generate::epc::Ocotp.xdm, category=SWCFG
          short-label=examples::EBT::S32G2::Pmic_Configuration_Example_S32G274A_M7::generate::epc::Platform.xdm, category=SWCFG
          short-label=examples::EBT::S32G2::Pmic_Configuration_Example_S32G274A_M7::generate::epc::Pmic.xdm, category=SWCFG
          short-label=examples::EBT::S32G2::Pmic_Configuration_Example_S32G274A_M7::generate::epc::Port.xdm, category=SWCFG
          short-label=examples::EBT::S32G2::Pmic_Configuration_Example_S32G274A_M7::generate::epc::Resource.xdm, category=SWCFG
          short-label=examples::EBT::S32G2::Pmic_Configuration_Example_S32G274A_M7::include::check_example.h, category=SWHDR
          short-label=examples::EBT::S32G2::Pmic_Configuration_Example_S32G274A_M7::src::main.c, category=SWSRC
          short-label=examples::EBT::S32G2::Pmic_Configuration_Example_S32G274A_M7::TresosProject::Pmic_Configuration_Example_S32G274A_M7::.prefs::preferences.xdm, category=SWCFG
          short-label=examples::EBT::S32G2::Pmic_Configuration_Example_S32G274A_M7::TresosProject::Pmic_Configuration_Example_S32G274A_M7::config::Base.xdm, category=SWCFG
          short-label=examples::EBT::S32G2::Pmic_Configuration_Example_S32G274A_M7::TresosProject::Pmic_Configuration_Example_S32G274A_M7::config::Dem.xdm, category=SWCFG
          short-label=examples::EBT::S32G2::Pmic_Configuration_Example_S32G274A_M7::TresosProject::Pmic_Configuration_Example_S32G274A_M7::config::Dio.xdm, category=SWCFG
          short-label=examples::EBT::S32G2::Pmic_Configuration_Example_S32G274A_M7::TresosProject::Pmic_Configuration_Example_S32G274A_M7::config::EcuC.xdm, category=SWCFG
          short-label=examples::EBT::S32G2::Pmic_Configuration_Example_S32G274A_M7::TresosProject::Pmic_Configuration_Example_S32G274A_M7::config::I2c.xdm, category=SWCFG
          short-label=examples::EBT::S32G2::Pmic_Configuration_Example_S32G274A_M7::TresosProject::Pmic_Configuration_Example_S32G274A_M7::config::Mcu.xdm, category=SWCFG
          short-label=examples::EBT::S32G2::Pmic_Configuration_Example_S32G274A_M7::TresosProject::Pmic_Configuration_Example_S32G274A_M7::config::Ocotp.xdm, category=SWCFG
          short-label=examples::EBT::S32G2::Pmic_Configuration_Example_S32G274A_M7::TresosProject::Pmic_Configuration_Example_S32G274A_M7::config::Platform.xdm, category=SWCFG
          short-label=examples::EBT::S32G2::Pmic_Configuration_Example_S32G274A_M7::TresosProject::Pmic_Configuration_Example_S32G274A_M7::config::Pmic.xdm, category=SWCFG
          short-label=examples::EBT::S32G2::Pmic_Configuration_Example_S32G274A_M7::TresosProject::Pmic_Configuration_Example_S32G274A_M7::config::Port.xdm, category=SWCFG
          short-label=examples::EBT::S32G2::Pmic_Configuration_Example_S32G274A_M7::TresosProject::Pmic_Configuration_Example_S32G274A_M7::config::Resource.xdm, category=SWCFG
          short-label=examples::EBT::S32G3::Pmic_Configuration_Example_S32G399A_M7::generate::epc::Base.xdm, category=SWCFG
          short-label=examples::EBT::S32G3::Pmic_Configuration_Example_S32G399A_M7::generate::epc::Dem.xdm, category=SWCFG
          short-label=examples::EBT::S32G3::Pmic_Configuration_Example_S32G399A_M7::generate::epc::Dio.xdm, category=SWCFG
          short-label=examples::EBT::S32G3::Pmic_Configuration_Example_S32G399A_M7::generate::epc::EcuC.xdm, category=SWCFG
          short-label=examples::EBT::S32G3::Pmic_Configuration_Example_S32G399A_M7::generate::epc::I2c.xdm, category=SWCFG
          short-label=examples::EBT::S32G3::Pmic_Configuration_Example_S32G399A_M7::generate::epc::Mcu.xdm, category=SWCFG
          short-label=examples::EBT::S32G3::Pmic_Configuration_Example_S32G399A_M7::generate::epc::Ocotp.xdm, category=SWCFG
          short-label=examples::EBT::S32G3::Pmic_Configuration_Example_S32G399A_M7::generate::epc::Platform.xdm, category=SWCFG
          short-label=examples::EBT::S32G3::Pmic_Configuration_Example_S32G399A_M7::generate::epc::Pmic.xdm, category=SWCFG
          short-label=examples::EBT::S32G3::Pmic_Configuration_Example_S32G399A_M7::generate::epc::Port.xdm, category=SWCFG
          short-label=examples::EBT::S32G3::Pmic_Configuration_Example_S32G399A_M7::generate::epc::Resource.xdm, category=SWCFG
          short-label=examples::EBT::S32G3::Pmic_Configuration_Example_S32G399A_M7::include::check_example.h, category=SWHDR
          short-label=examples::EBT::S32G3::Pmic_Configuration_Example_S32G399A_M7::src::main.c, category=SWSRC
          short-label=examples::EBT::S32G3::Pmic_Configuration_Example_S32G399A_M7::TresosProject::Pmic_Configuration_Example_S32G399A_M7::.prefs::preferences.xdm, category=SWCFG
          short-label=examples::EBT::S32G3::Pmic_Configuration_Example_S32G399A_M7::TresosProject::Pmic_Configuration_Example_S32G399A_M7::config::Base.xdm, category=SWCFG
          short-label=examples::EBT::S32G3::Pmic_Configuration_Example_S32G399A_M7::TresosProject::Pmic_Configuration_Example_S32G399A_M7::config::Dem.xdm, category=SWCFG
          short-label=examples::EBT::S32G3::Pmic_Configuration_Example_S32G399A_M7::TresosProject::Pmic_Configuration_Example_S32G399A_M7::config::Dio.xdm, category=SWCFG
          short-label=examples::EBT::S32G3::Pmic_Configuration_Example_S32G399A_M7::TresosProject::Pmic_Configuration_Example_S32G399A_M7::config::EcuC.xdm, category=SWCFG
          short-label=examples::EBT::S32G3::Pmic_Configuration_Example_S32G399A_M7::TresosProject::Pmic_Configuration_Example_S32G399A_M7::config::I2c.xdm, category=SWCFG
          short-label=examples::EBT::S32G3::Pmic_Configuration_Example_S32G399A_M7::TresosProject::Pmic_Configuration_Example_S32G399A_M7::config::Mcu.xdm, category=SWCFG
          short-label=examples::EBT::S32G3::Pmic_Configuration_Example_S32G399A_M7::TresosProject::Pmic_Configuration_Example_S32G399A_M7::config::Ocotp.xdm, category=SWCFG
          short-label=examples::EBT::S32G3::Pmic_Configuration_Example_S32G399A_M7::TresosProject::Pmic_Configuration_Example_S32G399A_M7::config::Platform.xdm, category=SWCFG
          short-label=examples::EBT::S32G3::Pmic_Configuration_Example_S32G399A_M7::TresosProject::Pmic_Configuration_Example_S32G399A_M7::config::Pmic.xdm, category=SWCFG
          short-label=examples::EBT::S32G3::Pmic_Configuration_Example_S32G399A_M7::TresosProject::Pmic_Configuration_Example_S32G399A_M7::config::Port.xdm, category=SWCFG
          short-label=examples::EBT::S32G3::Pmic_Configuration_Example_S32G399A_M7::TresosProject::Pmic_Configuration_Example_S32G399A_M7::config::Resource.xdm, category=SWCFG
          short-label=examples::S32DS::S32G2::Pmic_Configuration_Autosar_Example_S32G274A_M7::include::check_example.h, category=SWHDR
          short-label=examples::S32DS::S32G2::Pmic_Configuration_Autosar_Example_S32G274A_M7::Project_Settings::Startup_Code::exceptions.c, category=SWSRC
          short-label=examples::S32DS::S32G2::Pmic_Configuration_Autosar_Example_S32G274A_M7::Project_Settings::Startup_Code::nvic.c, category=SWSRC
          short-label=examples::S32DS::S32G2::Pmic_Configuration_Autosar_Example_S32G274A_M7::Project_Settings::Startup_Code::startup.c, category=SWSRC
          short-label=examples::S32DS::S32G2::Pmic_Configuration_Autosar_Example_S32G274A_M7::Project_Settings::Startup_Code::system.c, category=SWSRC
          short-label=examples::S32DS::S32G2::Pmic_Configuration_Autosar_Example_S32G274A_M7::src::main.c, category=SWSRC
          short-label=examples::S32DS::S32G2::Pmic_Configuration_Non_Autosar_Example_S32G274A_M7::include::check_example.h, category=SWHDR
          short-label=examples::S32DS::S32G2::Pmic_Configuration_Non_Autosar_Example_S32G274A_M7::Project_Settings::Startup_Code::exceptions.c, category=SWSRC
          short-label=examples::S32DS::S32G2::Pmic_Configuration_Non_Autosar_Example_S32G274A_M7::Project_Settings::Startup_Code::nvic.c, category=SWSRC
          short-label=examples::S32DS::S32G2::Pmic_Configuration_Non_Autosar_Example_S32G274A_M7::Project_Settings::Startup_Code::startup.c, category=SWSRC
          short-label=examples::S32DS::S32G2::Pmic_Configuration_Non_Autosar_Example_S32G274A_M7::Project_Settings::Startup_Code::system.c, category=SWSRC
          short-label=examples::S32DS::S32G2::Pmic_Configuration_Non_Autosar_Example_S32G274A_M7::src::main.c, category=SWSRC
          short-label=examples::S32DS::S32G3::Pmic_Configuration_Autosar_Example_S32G399A_M7::include::check_example.h, category=SWHDR
          short-label=examples::S32DS::S32G3::Pmic_Configuration_Autosar_Example_S32G399A_M7::Project_Settings::Startup_Code::exceptions.c, category=SWSRC
          short-label=examples::S32DS::S32G3::Pmic_Configuration_Autosar_Example_S32G399A_M7::Project_Settings::Startup_Code::nvic.c, category=SWSRC
          short-label=examples::S32DS::S32G3::Pmic_Configuration_Autosar_Example_S32G399A_M7::Project_Settings::Startup_Code::startup.c, category=SWSRC
          short-label=examples::S32DS::S32G3::Pmic_Configuration_Autosar_Example_S32G399A_M7::Project_Settings::Startup_Code::system.c, category=SWSRC
          short-label=examples::S32DS::S32G3::Pmic_Configuration_Autosar_Example_S32G399A_M7::src::main.c, category=SWSRC
          short-label=examples::S32DS::S32G3::Pmic_Configuration_Non_Autosar_Example_S32G399A_M7::include::check_example.h, category=SWHDR
          short-label=examples::S32DS::S32G3::Pmic_Configuration_Non_Autosar_Example_S32G399A_M7::Project_Settings::Startup_Code::exceptions.c, category=SWSRC
          short-label=examples::S32DS::S32G3::Pmic_Configuration_Non_Autosar_Example_S32G399A_M7::Project_Settings::Startup_Code::nvic.c, category=SWSRC
          short-label=examples::S32DS::S32G3::Pmic_Configuration_Non_Autosar_Example_S32G399A_M7::Project_Settings::Startup_Code::startup.c, category=SWSRC
          short-label=examples::S32DS::S32G3::Pmic_Configuration_Non_Autosar_Example_S32G399A_M7::Project_Settings::Startup_Code::system.c, category=SWSRC
          short-label=examples::S32DS::S32G3::Pmic_Configuration_Non_Autosar_Example_S32G399A_M7::src::main.c, category=SWSRC
          short-label=include::CDD_Pmic.h, category=SWHDR
          short-label=include::Pmic_Dem.h, category=SWHDR
          short-label=include::Pmic_Det.h, category=SWHDR
          short-label=include::Pmic_Internals.h, category=SWHDR
          short-label=include::Pmic_Ipw.h, category=SWHDR
          short-label=include::Pmic_Ipw_Types.h, category=SWHDR
          short-label=include::Pmic_Types.h, category=SWHDR
          short-label=include::Pmic_VR55XX.h, category=SWHDR
          short-label=include::Pmic_VR55XX_i2c_external_access.h, category=SWHDR
          short-label=include::Pmic_VR55XX_ocotp_external_access.h, category=SWHDR
          short-label=include::Pmic_VR55XX_pin_external_access.h, category=SWHDR
          short-label=include::Pmic_VR55XX_RegMap.h, category=SWHDR
          short-label=include::Pmic_VR55XX_Types.h, category=SWHDR
          short-label=src::CDD_Pmic.c, category=SWSRC
          short-label=src::Pmic_Dem.c, category=SWSRC
          short-label=src::Pmic_Det.c, category=SWSRC
          short-label=src::Pmic_Ipw.c, category=SWSRC
          short-label=src::Pmic_VR55XX.c, category=SWSRC
          short-label=src::Pmic_VR55XX_i2c_external_access.c, category=SWSRC
          short-label=src::Pmic_VR55XX_ocotp_external_access.c, category=SWSRC
          short-label=src::Pmic_VR55XX_pin_external_access.c, category=SWSRC
    compiler DIAB_Compiler:
      name=Windriver Diab
      options=-tARMCORTEXM7MG:simple -mthumb -std=c99 -Oz -g -fstandalone-debug -Wstrict-prototypes -Wsign-compare -Wdouble-promotion -Wunknown-pragmas -Wundef -Wextra -Wall -pedantic -Werror=implicit-function-declaration -fno-common -fno-signed-char -fno-trigraphs -V -c -DS32XX -DS32G2XX -DDIAB -DUSE_SW_VECTOR_MODE -DD_CACHE_ENABLE -DI_CACHE_ENABLE -DENABLE_FPU -DMCAL_ENABLE_USER_MODE_SUPPORT
      vendor=Windriver
      version=DIAB_7_0_3_0-FCS_20200409_160912
    compiler GCC_Compiler:
      name=GCC Compiler
      options=-mcpu=cortex-m7 -mthumb -mlittle-endian -mfpu=fpv5-sp-d16 -mfloat-abi=hard -std=c99 -Os -ggdb3 -Wall -Wextra -pedantic -Wstrict-prototypes -Wundef -Wunused -Werror=implicit-function-declaration -Wsign-compare -Wdouble-promotion -fno-short-enums -funsigned-char -funsigned-bitfields -fomit-frame-pointer -fno-common -fstack-usage -fdump-ipa-all -c -DS32XX -DS32G2XX -DGCC -DUSE_SW_VECTOR_MODE -DD_CACHE_ENABLE -DI_CACHE_ENABLE -DENABLE_FPU -DMCAL_ENABLE_USER_MODE_SUPPORT
      vendor=GCC Systems
      version=NXP GCC 9.2.0 20190812 (Build 1649 Revision gaf57174)
    compiler GHS_Compiler:
      name=Green Hills
      options=-cpu=cortexm7 -thumb -fpu=vfpv5_d16 -fsingle -C99 --ghstd=last -Osize --gnu_asm -dual_debug -G -keeptempfiles -Wimplicit-int -Wshadow -Wtrigraphs -Wundef --unsigned_chars --unsigned_fields --no_commons --no_exceptions --no_slash_comment --prototype_errors --incorrect_pragma_warnings -c -DS32XX -DS32G2XX -DGHS -DUSE_SW_VECTOR_MODE -DD_CACHE_ENABLE -DI_CACHE_ENABLE -DENABLE_FPU -DMCAL_ENABLE_USER_MODE_SUPPORT
      vendor=Green Hills
      version=Green Hills Multi 7.1.6d / Compiler 2020.1.4
    generated-artifacts:
      6 x dependency on artifact:
        CDD_Pmic_Cfg_h: artifact-descriptor={short-label=generate_PB::include::CDD_Pmic_Cfg.h, category=SWHDR}, usages=EXECUTE
        CDD_Pmic_PBcfg_h: artifact-descriptor={short-label=generate_PB::include::CDD_Pmic_PBcfg.h, category=SWHDR}, usages=EXECUTE
        CDD_Pmic_Cfg_c: artifact-descriptor={short-label=generate_PB::src::CDD_Pmic_Cfg.c, category=SWSRC}, usages=EXECUTE
        CDD_Pmic_PBcfg_c: artifact-descriptor={short-label=generate_PB::src::CDD_Pmic_PBcfg.c, category=SWSRC}, usages=EXECUTE
        CDD_Pmic_Cfg_h: artifact-descriptor={short-label=generate_PC::include::CDD_Pmic_Cfg.h, category=SWHDR}, usages=COMPILE
        CDD_Pmic_Cfg_c: artifact-descriptor={short-label=generate_PC::src::CDD_Pmic_Cfg.c, category=SWSRC}, usages=COMPILE
    linker DIAB_Linker: name=Windriver Diab, options=-e Reset_Handler linker_script_file.dld -m30 -Xstack-usage -Xpreprocess-lecl -Llibrary_path -lc -lm, vendor=Windriver, version=DIAB_7_0_3_0-FCS_20200409_160912
    linker GCC_Linker: name=GCC Compiler, options=-Wl,-Map,filename -T linkerfile --entry=Reset_Handler -nostartfiles -mcpu=cortexm7 -mthumb -mfpu=fpv5-sp-d16 -mfloat-abi=hard -mlittle-endian -ggdb3 -lc -lm -lgcc, vendor=GCC Systems, version=NXP GCC 9.2.0 20190812 (Build 1649 Revision gaf57174)
    linker GHS_Linker: name=Green Hills, options=-e Reset_Handler -T linker_script_file.ld -map -keepmap -Mn -delete -ignore_debug_references -Llibrary_path -larch -lstartup -lind_sd -v -nostartfiles, vendor=Green Hills, version=Green Hills Multi 7.1.6d / Compiler 2020.1.4
    resource consumption ResourceConsumption
      7 x memory section:
        PMIC_CODE: alignment=UNSPECIFIED, sw-addrmethod=CODE, symbol=CODE
        PMIC_CONFIG_DATA_UNSPECIFIED: alignment=UNSPECIFIED, sw-addrmethod=CONFIG_DATA, symbol=CONFIG_DATA_UNSPECIFIED
        PMIC_CONST_8: alignment=8, sw-addrmethod=CONST, symbol=CONST_8
        PMIC_CONST_UNSPECIFIED: alignment=UNSPECIFIED, sw-addrmethod=CONST, symbol=CONST_UNSPECIFIED
        PMIC_VAR_CLEARED_16: alignment=16, sw-addrmethod=VAR_CLEARED, symbol=VAR_CLEARED_16
        PMIC_VAR_CLEARED_BOOLEAN: alignment=BOOLEAN, sw-addrmethod=VAR_CLEARED, symbol=VAR_CLEARED_BOOLEAN
        PMIC_VAR_CLEARED_UNSPECIFIED: alignment=UNSPECIFIED, sw-addrmethod=VAR_CLEARED, symbol=VAR_CLEARED_UNSPECIFIED
